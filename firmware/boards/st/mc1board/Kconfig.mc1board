## firmware/boards/st/mc1board/Kconfig.mc1board
```kconfig
# Copyright (c) 2023 STMicroelectronics
# SPDX-License-Identifier: Apache-2.0

config BOARD_MC1BOARD
	select SOC_STM32H573XX
```

## firmware/boards/st/mc1board/board.yml
```yaml
board:
  name: mc1board
  full_name: MC1 Board
  vendor: ZHAW
  socs:
    - name: stm32h573xx
```

## firmware/modules/touch/drivers/input/Kconfig
```kconfig
# Copyright (c) 2026 ZHAW <www.zhaw.ch>
# SPDX-License-Identifier: Apache-2.0
config INPUT_TSC2007
    bool "TSC2007 touch driver"
    default y
    depends on DT_HAS_TI_TSC2007_ENABLED
    select I2C
    select INPUT_TOUCH
    help
        Enable driver for STMPE811 touch panel.
```
