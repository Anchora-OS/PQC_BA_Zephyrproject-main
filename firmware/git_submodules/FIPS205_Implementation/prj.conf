## CMakeLists.txt
```
cmake_minimum_required(VERSION 3.20.0)

set(BOARD_ROOT "${CMAKE_CURRENT_SOURCE_DIR}/..//../")
set(BOARD "mc1board")
set(BOARD_FLASH_RUNNER "jlink")
set(BOARD_DEBUG_RUNNER "jlink")

find_package(Zephyr REQUIRED HINTS $ENV{ZEPHYR_BASE})
project(FIPS205_Implementation)

target_link_libraries(app PRIVATE mbedTLS)

# Add source files here
target_sources(app PRIVATE
    src/main.cpp
    src/Fips205_implementation.c
    src/USBcommunication.cpp
    src/RSAPSS_implementation.cpp
    src/Fips205_Files/sha2_256.c
    src/Fips205_Files/sha2_512.c
    src/Fips205_Files/sha3_api.c
    src/Fips205_Files/sha3_f1600.c
    src/Fips205_Files/slh_dsa.c
    src/Fips205_Files/slh_prehash.c
    src/Fips205_Files/slh_sha2.c
    src/Fips205_Files/slh_shake.c
)

target_include_directories(app PRIVATE
    src/
)

# Suppress C++17 'register' warnings emitted from STM32 HAL third-party headers.
target_compile_options(app PRIVATE
    $<$<COMPILE_LANGUAGE:CXX>:-Wno-register>
)
```

## prj.conf
```kconfig
## Configure memory
CONFIG_MAIN_STACK_SIZE=65536

CONFIG_THREAD_STACK_INFO=y
CONFIG_INIT_STACKS=y
#CONFIG_THREAD_ANALYZER=y
#CONFIG_THREAD_ANALYZER_AUTO=y

## configure RSA Math functions
CONFIG_MBEDTLS=y
CONFIG_MBEDTLS_BUILTIN=y
CONFIG_MBEDTLS_CTR_DRBG_C=y
CONFIG_MBEDTLS_ENTROPY_C=y
CONFIG_MBEDTLS_RSA_C=y
CONFIG_MBEDTLS_SHA256=y
CONFIG_MBEDTLS_PKCS1_V21=y   # PSS + OAEP
CONFIG_MBEDTLS_CIPHER_AES_ENABLED=y
#CONFIG_MBEDTLS_BIGNUM=y

CONFIG_MBEDTLS_GENPRIME_ENABLED=y
#CONFIG_ENTROPY=y
#CONFIG_ENTROPY_STM32=y
CONFIG_ENTROPY_GENERATOR=y


## Configure Power Management
#CONFIG_PM=y

## Configure USB peripheral

CONFIG_USB_DEVICE_STACK_NEXT=y
CONFIG_USB_CDC_ACM=n
CONFIG_USB_DEVICE_STACK=n
CONFIG_LOG_PRINTK=n

# Enable USB device support
#CONFIG_USBD=y

# Enable CDC ACM class (NEW API)
#CONFIG_USBD_CDC_ACM=y

# Initialize automatically
#CONFIG_USBD_CDC_ACM_INIT_AT_BOOT=y
CONFIG_CDC_ACM_SERIAL_INITIALIZE_AT_BOOT=y

# Optional descriptors
#CONFIG_USBD_MANUFACTURER="USB_Debugger_PQC_Implementation"
#CONFIG_USBD_PRODUCT="Zephyr USB"
## Configure GPIO
CONFIG_GPIO=y

## Configure SPI
CONFIG_SPI=n
CONFIG_SPI_STM32=n
CONFIG_DMA=n
CONFIG_SPI_STM32_DMA=n

## Configure PWM
CONFIG_PWM=n
CONFIG_PWM_STM32=n
CONFIG_PINCTRL=y

## Activate serial console
CONFIG_SERIAL=y
CONFIG_CONSOLE=y
CONFIG_UART_CONSOLE=y
#CONFIG_USB_UART_CONSOLE=n
#CONFIG_STDOUT_CONSOLE=y
#CONFIG_UART_LINE_CTRL=y

## Configure Logging
CONFIG_LOG=y
CONFIG_LOG_DEFAULT_LEVEL=3
CONFIG_LOG_MODE_DEFERRED=y

## Enable SEGGER RTT logging
CONFIG_USE_SEGGER_RTT=y
CONFIG_RTT_CONSOLE=n
CONFIG_PRINTK=y
CONFIG_LOG_BACKEND_RTT=y
CONFIG_LOG_BACKEND_RTT_MODE_BLOCK=y

## Config Events
CONFIG_EVENTS=y

## Configure Display
CONFIG_DISPLAY=n
CONFIG_FLASH=n
CONFIG_SPI=n

## Enable regulator framwork for LCD backlight
CONFIG_REGULATOR=n

## Configure LVGL
CONFIG_LVGL=n
CONFIG_LV_USE_LABEL=n
CONFIG_LV_USE_LOG=n

CONFIG_LV_COLOR_DEPTH_16=n
CONFIG_LV_FONT_MONTSERRAT_18=n
#CONFIG_LV_Z_MEM_POOL_SIZE=n
##16384
## important to swap upper and lower bytes of the pixels
CONFIG_LV_COLOR_16_SWAP=n

CONFIG_LV_USE_BUTTON=n
CONFIG_LV_USE_ARC=n
CONFIG_LV_USE_IMAGE=n

## General for Ethernet
#CONFIG_POSIX_API=n

## Networking Config
#CONFIG_NETWORKING=n
#CONFIG_NET_IPV4=n
#CONFIG_NET_IPV6=n
#CONFIG_NET_SOCKETS=n
```

## mc1board.overlay
```dts
/ {
    chosen {
        zephyr,console = &cdc_acm_uart0;
    };
};

&zephyr_udc0 {
    status = "okay";

    cdc_acm_uart0: cdc_acm_uart0 {
        compatible = "zephyr,cdc-acm-uart";
    };
};
```

## src/Fips205_implementation.c
```c
#include "Fips205_implementation.h"
#include <zephyr/random/random.h>
#include <string.h>
#include "Fips205_Files/slh_dsa.h"

// ---------------- CONFIG ----------------

// Example: SLH-DSA-SHA2-128s
#define PARAMS (&slh_dsa_sha2_128s)
#define FIPS205_PK_BYTES 32
#define FIPS205_SK_BYTES 64
#define FIPS205_SIG_BYTES 7856

// ---------------- GLOBAL STATE ----------------

static uint8_t pubkey[FIPS205_PK_BYTES];
static uint8_t seckey[FIPS205_SK_BYTES];
static uint8_t signature[FIPS205_SIG_BYTES];
static uint8_t message[32];
static size_t signature_len;

/**
 * @brief Generate random bytes for FIPS205 operations.
 *
 * Fills a buffer using Zephyr's random source.
 *
 * @param[out] buf Destination buffer
 * @param[in] len Number of bytes to generate
 * @return int Always returns 0
 */
static int fill_random(uint8_t *buf, size_t len)
{
    sys_rand_get(buf, len);
    return 0;
}

// ---------------- KEYGEN ----------------

/**
 * @brief Generate the FIPS205 keypair.
 *
 * Calls the SLH-DSA key generation routine with the fixed parameter set.
 *
 * @return int 0 on success, non-zero on failure
 */
int fips205_generate_keys(void)
{
    return slh_keygen(seckey, pubkey, fill_random, PARAMS);
}

// ---------------- SIGN ----------------

/**
 * @brief Sign the current FIPS205 message buffer.
 *
 * Generates fresh message bytes, signs them and stores the signature length.
 *
 * @return int 0 on success, -1 on failure
 */
int fips205_sign(void)
{
    fill_random(message, sizeof(message));

    signature_len = slh_sign(signature, message, sizeof(message), NULL, 0,
            seckey, NULL, PARAMS);
    return signature_len == 0 ? -1 : 0;
}

// ---------------- VERIFY ----------------

/**
 * @brief Verify the stored FIPS205 signature.
 *
 * Checks whether the signature matches the current message and public key.
 *
 * @return int 0 on success, -1 on missing signature, other non-zero on verify failure
 */
int fips205_verify(void)
{
    if (signature_len == 0)
    {
        return -1;
    }

    return slh_verify(message, sizeof(message), signature, signature_len,
            NULL, 0, pubkey, PARAMS);
}

// ---------------- GETTERS ----------------

/**
 * @brief Return the generated FIPS205 public key buffer.
 *
 * Provides a pointer to the in-memory public key for transport.
 *
 * @return const uint8_t* Pointer to public key bytes
 */
const uint8_t *fips205_get_public_key(void)
{ return pubkey; }

/**
 * @brief Return the generated FIPS205 signature buffer.
 *
 * Provides a pointer to the current signature bytes.
 *
 * @return const uint8_t* Pointer to signature bytes
 */
const uint8_t *fips205_get_signature(void)
{ return signature; }

/**
 * @brief Return the generated FIPS205 message buffer.
 *
 * Provides a pointer to the message that was signed.
 *
 * @return const uint8_t* Pointer to message bytes
 */
const uint8_t *fips205_get_message(void)
{ return message; }

/**
 * @brief Return the size of the public key buffer.
 *
 * Reports the key size for the current parameter set.
 *
 * @return size_t Public key length in bytes
 */
size_t fips205_get_public_key_len(void)
{
    return slh_pk_sz(PARAMS);
}

/**
 * @brief Return the size of the signature buffer.
 *
 * Reports the signature size or the current signature length if set.
 *
 * @return size_t Signature length in bytes
 */
size_t fips205_get_signature_len(void)
{
    return signature_len == 0 ? slh_sig_sz(PARAMS) : signature_len;
}

/**
 * @brief Return the size of the message buffer.
 *
 * Reports the fixed message buffer size used during signing.
 *
 * @return size_t Message length in bytes
 */
size_t fips205_get_message_len(void)
{
    return sizeof(message);
}
```

## src/Fips205_implementation.h
```c
#ifndef FIPS205_IMPLEMENTATION_H
#define FIPS205_IMPLEMENTATION_H

#include <stddef.h>
#include <stdint.h>

#ifdef __cplusplus
extern "C" {
#endif

/**
 * @brief Generate a FIPS205 (SLH-DSA) keypair.
 *
 * Calls the underlying SLH-DSA key generation with the chosen parameter set.
 *
 * @return int 0 on success, non-zero on failure
 */
int fips205_generate_keys(void);

/**
 * @brief Sign a fresh message using FIPS205 (SLH-DSA).
 *
 * Generates a random message, signs it with the secret key and stores the
 * signature for later retrieval.
 *
 * @return int 0 on success, -1 on failure
 */
int fips205_sign(void);

/**
 * @brief Verify the currently stored signature against the stored message.
 *
 * @return int 0 on success, -1 if no signature present, other non-zero on failure
 */
int fips205_verify(void);

const uint8_t *fips205_get_public_key(void);
const uint8_t *fips205_get_signature(void);
const uint8_t *fips205_get_message(void);

size_t fips205_get_public_key_len(void);
size_t fips205_get_signature_len(void);
size_t fips205_get_message_len(void);

#ifdef __cplusplus
}
#endif

#endif /* FIPS205_IMPLEMENTATION_H */
```

## src/RSAPSS_implementation.cpp
```c
#include "RSAPSS_implementation.h"
#include <mbedtls/rsa.h>
#include <mbedtls/sha256.h>
#include <mbedtls/ctr_drbg.h>
#include <mbedtls/entropy.h>
#include <string.h>
#include <stdio.h>
#include "USBcommunication.h"


// Global RNG context used by the RSA-PSS helpers.
static mbedtls_entropy_context entropy;
static mbedtls_ctr_drbg_context ctr_drbg;
static int rng_initialized;

/**
 * @brief Format and print an mbedTLS error.
 *
 * Converts a negative error code into a readable hex message and sends it
 * to the USB console.
 *
 * @param[in] context Operation name
 * @param[in] err mbedTLS error code
 */
static void report_mbedtls_error(const char *context, int err)
{
    char msg[96];
    snprintf(msg, sizeof(msg), "%s failed: 0x%04X", context, (unsigned int) (-err));
    USB_print(msg);
}

/**
 * @brief Initialize the RNG context used by RSA-PSS.
 *
 * Sets up entropy and DRBG once and reuses them for later calls.
 *
 * @return int 0 on success, non-zero on failure
 */
static int init_rng(void)
{
    int ret;

    if (rng_initialized)
    {
        return 0;
    }

    mbedtls_entropy_init(&entropy);
    mbedtls_ctr_drbg_init(&ctr_drbg);

    const char *pers = "rsa_pss_demo";  // Personalization string for DRBG seeding
    ret = mbedtls_ctr_drbg_seed(&ctr_drbg, mbedtls_entropy_func, &entropy,
            (const unsigned char *) pers, strlen(pers));
    if (ret != 0)
    {
        report_mbedtls_error("mbedtls_ctr_drbg_seed", ret);
        return ret;
    }

    rng_initialized = 1;
    return 0;
}

// ---------------- KEYGEN ----------------

/**
 * @brief Generate an RSA-2048 keypair.
 *
 * Initializes the key context, applies PSS padding and creates the key.
 *
 * @param[out] rsa Destination RSA context
 * @return int 0 on success, non-zero on failure
 */
int rsa_pss_generate_keys(mbedtls_rsa_context *rsa)
{
    int ret;

    if (rsa == NULL)
    {
        USB_print("rsa_pss_generate_keys: rsa is NULL");
        return MBEDTLS_ERR_RSA_BAD_INPUT_DATA;
    }

    ret = init_rng();
    if (ret != 0)
    {
        return ret;
    }

    mbedtls_rsa_init(rsa);
    mbedtls_rsa_set_padding(rsa, MBEDTLS_RSA_PKCS_V21, MBEDTLS_MD_SHA256);  // Configure RSA context for PSS with SHA-256

    ret = mbedtls_rsa_gen_key(rsa, mbedtls_ctr_drbg_random, &ctr_drbg, 2048, 65537);    // Generate a 2048-bit RSA key with public exponent 65537.
    if (ret != 0)
    {
        report_mbedtls_error("mbedtls_rsa_gen_key", ret);
        return ret;
    }

    ret = mbedtls_rsa_check_privkey(rsa);
    if (ret != 0)
    {
        report_mbedtls_error("mbedtls_rsa_check_privkey", ret);
        return ret;
    }

    return 0;
}

// ---------------- SIGN ----------------

/**
 * @brief Sign a message using RSA-PSS.
 *
 * Hashes the message with SHA-256 and writes the signature buffer.
 *
 * @param[in] rsa Initialized RSA context
 * @param[in] message Data to sign
 * @param[in] message_len Length of data to sign
 * @param[out] signature Output buffer for signature
 * @param[out] sig_len Output length pointer for signature
 * @return int 0 on success, non-zero on failure
 */
int rsa_pss_sign(mbedtls_rsa_context *rsa,
                 const unsigned char *message, size_t message_len,
                 unsigned char *signature, size_t *sig_len)
{
    int ret;
    unsigned char hash[32]; // SHA-256 digest of the message.

    if (rsa == NULL || message == NULL || signature == NULL || sig_len == NULL)
    {
        USB_print("rsa_pss_sign: invalid argument");
        return MBEDTLS_ERR_RSA_BAD_INPUT_DATA;
    }

    ret = init_rng();
    if (ret != 0)
    {
        return ret;
    }

    // Hash first so the RSA-PSS call signs a fixed-size digest.
    mbedtls_sha256(message, message_len, hash, 0);

    // Sign the digest with the configured RSA-PSS parameters.
    ret = mbedtls_rsa_rsassa_pss_sign(rsa,
            mbedtls_ctr_drbg_random, &ctr_drbg,
            MBEDTLS_MD_SHA256,
            sizeof(hash),
            hash,
            signature);
    if (ret == 0)
    {
        *sig_len = mbedtls_rsa_get_len(rsa);
    }
    else
    {
        report_mbedtls_error("mbedtls_rsa_rsassa_pss_sign", ret);
    }

    return ret;
}

// ---------------- VERIFY ----------------

/**
 * @brief Verify a message using RSA-PSS.
 *
 * Hashes the message and checks it against the provided signature.
 *
 * @param[in] rsa Initialized RSA context
 * @param[in] message Signed data
 * @param[in] message_len Length of signed data
 * @param[in] signature Signature buffer
 * @param[in] sig_len Signature length
 * @return int 0 on success, non-zero on failure
 */
int rsa_pss_verify(mbedtls_rsa_context *rsa,
                   const unsigned char *message, size_t message_len,
                   const unsigned char *signature, size_t sig_len)
{
    int ret;
    unsigned char hash[32]; // SHA-256 digest of the message.

    if (rsa == NULL || message == NULL || signature == NULL)
    {
        USB_print("rsa_pss_verify: invalid argument");
        return MBEDTLS_ERR_RSA_BAD_INPUT_DATA;
    }

    if (sig_len != mbedtls_rsa_get_len(rsa))
    {
        USB_print("rsa_pss_verify: signature length mismatch");
        return MBEDTLS_ERR_RSA_VERIFY_FAILED;
    }

    // Recreate the digest so verification matches the signing step.
    mbedtls_sha256(message, message_len, hash, 0);

    // Verify the RSA-PSS signature against the digest.
    ret = mbedtls_rsa_rsassa_pss_verify(rsa,
            MBEDTLS_MD_SHA256,
            sizeof(hash),
            hash,
            signature);
    if (ret != 0)
    {
        report_mbedtls_error("mbedtls_rsa_rsassa_pss_verify", ret);
    }

    return ret;
}

/**
 * @brief Release RSA-PSS resources.
 *
 * Frees the RSA context and the shared entropy/DRBG state.
 *
 * @param[in] rsa RSA context to free
 */
void rsa_free(mbedtls_rsa_context *rsa)
{
    mbedtls_rsa_free(rsa);
    mbedtls_ctr_drbg_free(&ctr_drbg);
    mbedtls_entropy_free(&entropy);
    rng_initialized = 0;
}
```

## src/RSAPSS_implementation.h
```c
#ifndef RSA_PSS_IMPLEMENTATION_H
#define RSA_PSS_IMPLEMENTATION_H

#include <mbedtls/rsa.h>
#include <stddef.h>

/**
 * @brief Generate an RSA-2048 keypair configured for PSS/SHA-256.
 *
 * @param[out] rsa Initialized RSA context to receive the new keypair
 * @return int 0 on success, non-zero on failure
 */
int rsa_pss_generate_keys(mbedtls_rsa_context *rsa);

/**
 * @brief Sign a message using RSA-PSS (SHA-256).
 *
 * Hashes the input with SHA-256 and produces a PSS signature.
 *
 * @param[in] rsa Initialized RSA context
 * @param[in] message Data to sign
 * @param[in] message_len Length of data to sign
 * @param[out] signature Output buffer for the signature
 * @param[out] sig_len Pointer to receive signature length
 * @return int 0 on success, non-zero on failure
 */
int rsa_pss_sign(mbedtls_rsa_context *rsa,
                 const unsigned char *message, size_t message_len,
                 unsigned char *signature, size_t *sig_len);

/**
 * @brief Verify an RSA-PSS signature.
 *
 * @param[in] rsa Initialized RSA context
 * @param[in] message Signed data
 * @param[in] message_len Length of signed data
 * @param[in] signature Signature buffer
 * @param[in] sig_len Signature length
 * @return int 0 on success, non-zero on failure
 */
int rsa_pss_verify(mbedtls_rsa_context *rsa,
                   const unsigned char *message, size_t message_len,
                   const unsigned char *signature, size_t sig_len);

/**
 * @brief Free RSA and RNG resources used by the RSA-PSS helpers.
 *
 * Frees the provided RSA context and releases the shared CTR-DRBG/entropy
 * state used by this module.
 *
 * @param[in] rsa RSA context to free
 */
void rsa_free(mbedtls_rsa_context *rsa);

#endif // RSA_PSS_IMPLEMENTATION_H
```

## src/USBcommunication.cpp
```c
#include <stddef.h>
#include <zephyr/kernel.h>
#include <stdint.h>
#include <zephyr/sys/printk.h>
#include "USBcommunication.h"
#include <string.h>

// Small delay to keep USB prints stable on the host side.
#define SLEEP_TIME_MS 100

/**
 * @brief Send key, signature, and message payload over USB.
 *
 * Splits the formatted payload into labeled sections and streams them.
 *
 * @param[in] str Payload in the form pub@sig@msg
 */
void USB_send_key_and_signature(const char *str)
{
    k_msleep(SLEEP_TIME_MS);
    const size_t CHUNK_SIZE = 256;
    k_msleep(SLEEP_TIME_MS);

    if (str == NULL)
    {
        return;
    }

    // Find the field separators in the payload: pub@sig@msg.
    const char *sep1 = strchr(str, '@');
    if (!sep1)
    {
        // Fallback: send the whole line with a prefix.
        printk("@%s\n", str);
        return;
    }
    const char *sep2 = strchr(sep1 + 1, '@');
    if (!sep2)
    {
        // Malformed payload: send the whole line with a prefix.
        printk("@%s\n", str);
        return;
    }

    const char *pub_start = str;
    size_t pub_len = (size_t) (sep1 - pub_start);
    const char *sig_start = sep1 + 1;
    size_t sig_len = (size_t) (sep2 - sig_start);
    const char *msg_start = sep2 + 1;
    size_t msg_len = strlen(msg_start);

    // Stream each section with a label so the host can parse the payload.
    auto send_labeled = [&](const char *label, const char *data, size_t len)
    {
        size_t offset = 0;
        // Start marker for this field.
        printk("@%s\n", label);
        while (offset < len)
        {
            size_t to_send = (len - offset) > CHUNK_SIZE ? CHUNK_SIZE : (len - offset);
            printk("%.*s", (int) to_send, data + offset);
            offset += to_send;
            k_msleep(20);
        }
        // Ensure a clean end marker after each field.
        printk("\n@END_%s\n", label);
        k_msleep(10);
    };

    // Send public key, signature, and message separately with labels.
    send_labeled("PUB", pub_start, pub_len);
    send_labeled("SIG", sig_start, sig_len);
    send_labeled("MSG", msg_start, msg_len);

    // Final marker so the host knows the transfer is complete.
    printk("@END_ALL\n");


}

/**
 * @brief Send a plain text line over USB.
 *
 * Waits briefly and prints (sends) the provided string.
 *
 * @param[in] str Null-terminated text to send
 */
void USB_print(const char *str)
{
    k_msleep(SLEEP_TIME_MS);
    printk("%s\n", str);
}

/**
 * @brief Send structured CSV data over USB.
 *
 * Wraps the payload in start/stop markers and streams it in chunks.
 *
 * @param[in] str CSV text with embedded newlines
 */
void USB_send_structured_data(const char *str)
{
    const size_t CHUNK_SIZE = 256;
    size_t len = strlen(str);
    size_t offset = 0;

    // Send start delimiter.
    k_msleep(SLEEP_TIME_MS);
    printk("#start#\n");

    // Stream the CSV payload in chunks to avoid long single USB transfers.
    while (offset < len)
    {
        size_t to_send = (len - offset) > CHUNK_SIZE ? CHUNK_SIZE : (len - offset);
        printk("%.*s", (int) to_send, str + offset);
        offset += to_send;
        k_msleep(20); // Short pause between chunks for stability
    }

    // Ensure newline before stop delimiter and send stop.
    printk("\n#stop#\n");
}
```

## src/USBcommunication.h
```c
#ifndef USBCOMMUNICATION_H
#define USBCOMMUNICATION_H

/**
 * @brief Send a packed payload containing public key, signature and message.
 *
 * The payload format is "base64(pub)@base64(sig)@base64(msg)"; the
 * receiver splits on '@' and decodes each field.
 *
 * @param[in] str Payload string in the described format
 */
void USB_send_key_and_signature(const char *str);

/**
 * @brief Send a single line of text over USB.
 *
 * @param[in] str Null-terminated string to send
 */
void USB_print(const char *str);

/**
 * @brief Send structured CSV data over USB wrapped with start/stop markers.
 *
 * @param[in] str CSV text with embedded newlines
 */
void USB_send_structured_data(const char *str);

#endif
```
