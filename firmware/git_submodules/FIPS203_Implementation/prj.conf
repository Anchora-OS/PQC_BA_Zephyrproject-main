## CMakeLists.txt
```
cmake_minimum_required(VERSION 3.20.0)

set(BOARD_ROOT "${CMAKE_CURRENT_SOURCE_DIR}/..//../")
set(BOARD "mc1board")
set(BOARD_FLASH_RUNNER "jlink")
set(BOARD_DEBUG_RUNNER "jlink")

find_package(Zephyr REQUIRED HINTS $ENV{ZEPHYR_BASE})
project(FIPS203_Implementation)

# Option to build with mock FIPS203 implementation 
option(USE_FIPS203_MOCK "Build with mock FIPS203 implementation instead of ML-KEM" OFF)
# change this to ON to enable a mock implementation of FIPS203 to test the host programm for false positives

# Propagate compile-time define for selection
if(USE_FIPS203_MOCK)
    target_compile_definitions(app PRIVATE -DUSE_FIPS203_MOCK=1)
else()
    target_compile_definitions(app PRIVATE -DUSE_FIPS203_MOCK=0)
endif()

target_sources(app PRIVATE
    src/main.c
    src/ECDHA_implementation.c
    src/user_usb.c
    src/Fips203_implementation.cpp
    src/Fips203_implementation.c
    src/Fips203_dispatch.c
)

# Enable C++20 for ml-kem library
target_compile_options(app PRIVATE $<$<COMPILE_LANGUAGE:CXX>:-std=c++20>)

target_include_directories(app PRIVATE
    ${CMAKE_CURRENT_SOURCE_DIR}/src
    "${CMAKE_CURRENT_SOURCE_DIR}/Fips203 C++ implementation Full Repo/ml-kem/include"
    "${CMAKE_CURRENT_SOURCE_DIR}/Fips203 C++ implementation Full Repo/sha3/include"
    "${CMAKE_CURRENT_SOURCE_DIR}/Fips203 C++ implementation Full Repo/randomshake/include"
    "${CMAKE_CURRENT_SOURCE_DIR}/Fips203 C++ implementation Full Repo/subtle/include"
)
```

## prj.conf
```kconfig
## Configure memory
## ------------------------------------------------------------
## Core / Threading
## ------------------------------------------------------------
CONFIG_MAIN_STACK_SIZE=131072
CONFIG_STATIC_INIT_GNU=y
CONFIG_CPP=y
CONFIG_STD_CPP20=y
CONFIG_GLIBCXX_LIBCPP=y
CONFIG_THREAD_STACK_INFO=y
CONFIG_INIT_STACKS=y

## Power Management
#CONFIG_PM=y

## ------------------------------------------------------------
## USB (legacy + new USBD notes)
## ------------------------------------------------------------
CONFIG_USB_DEVICE_STACK_NEXT=y
CONFIG_USB_CDC_ACM=n
CONFIG_USB_DEVICE_STACK=n

# Enable USB device support
#CONFIG_USBD=y

# Enable CDC ACM class (NEW API)
#CONFIG_USBD_CDC_ACM=y

# Optional descriptors
#CONFIG_USBD_MANUFACTURER="USB_Debugger_PQC_Implementation"
#CONFIG_USBD_PRODUCT="Zephyr USB"

## USB Serial / UART add-ons
# DUPLICATE: already set above with same value.
CONFIG_USB_DEVICE_STACK_NEXT=y
CONFIG_USBD_CDC_ACM_CLASS=y
#CONFIG_CDC_ACM_SERIAL_PID=0x0001
#CONFIG_CDC_ACM_SERIAL_PRODUCT_STRING="USBD PQC"

# Enable USB initialization at boot
CONFIG_CDC_ACM_SERIAL_INITIALIZE_AT_BOOT=n

## USB logging levels
CONFIG_USBD_LOG_LEVEL_ERR=y
CONFIG_UDC_DRIVER_LOG_LEVEL_ERR=y
CONFIG_USBD_CDC_ACM_LOG_LEVEL_OFF=y

## ------------------------------------------------------------
## GPIO / Pin / Peripheral buses
## ------------------------------------------------------------
CONFIG_GPIO=y

## SPI
CONFIG_SPI=n
CONFIG_SPI_STM32=n
CONFIG_DMA=n
CONFIG_SPI_STM32_DMA=n

## PWM
CONFIG_PWM=n
CONFIG_PWM_STM32=n
CONFIG_PINCTRL=y

## ------------------------------------------------------------
## Console / Serial
## ------------------------------------------------------------
CONFIG_SERIAL=y
CONFIG_CONSOLE=y
CONFIG_UART_CONSOLE=y
#CONFIG_USB_UART_CONSOLE=n
#CONFIG_STDOUT_CONSOLE=y
#CONFIG_UART_LINE_CTRL=y

CONFIG_STDOUT_CONSOLE=y
# DUPLICATE: already set above with same value.
CONFIG_SERIAL=y
CONFIG_UART_LINE_CTRL=y

## ------------------------------------------------------------
## Logging / RTT
## ------------------------------------------------------------
CONFIG_LOG=y
CONFIG_LOG_DEFAULT_LEVEL=3
CONFIG_LOG_MODE_DEFERRED=y

## SEGGER RTT logging
CONFIG_USE_SEGGER_RTT=y
CONFIG_RTT_CONSOLE=n
CONFIG_PRINTK=y
CONFIG_LOG_BACKEND_RTT=y
CONFIG_LOG_BACKEND_RTT_MODE_BLOCK=y

# DUPLICATE: already set above with same value.
CONFIG_LOG=y

## ------------------------------------------------------------
## Events
## ------------------------------------------------------------
CONFIG_EVENTS=y

## ------------------------------------------------------------
## Display / Flash / Regulator / LVGL
## ------------------------------------------------------------
CONFIG_DISPLAY=n
CONFIG_FLASH=n

# DUPLICATE: already set above with same value.
CONFIG_SPI=n

## Enable regulator framework for LCD backlight
CONFIG_REGULATOR=n

## LVGL
CONFIG_LVGL=n
CONFIG_LV_USE_LABEL=n
CONFIG_LV_USE_LOG=n

CONFIG_LV_COLOR_DEPTH_16=n
CONFIG_LV_FONT_MONTSERRAT_18=n
#CONFIG_LV_Z_MEM_POOL_SIZE=n
##16384
## important to swap upper and lower bytes of the pixels
CONFIG_LV_COLOR_16_SWAP=n

CONFIG_LV_USE_BUTTON=n
CONFIG_LV_USE_ARC=n
CONFIG_LV_USE_IMAGE=n

## ------------------------------------------------------------
## Ethernet / Networking (currently commented)
## ------------------------------------------------------------
#CONFIG_POSIX_API=n

#CONFIG_NETWORKING=n
#CONFIG_NET_IPV4=n
#CONFIG_NET_IPV6=n
#CONFIG_NET_SOCKETS=n
```

## mc1board.overlay
```dts
/ {
    chosen {
        //zephyr,console = &cdc_acm_uart0;
    };
};

&zephyr_udc0 {
    cdc_acm_uart0: cdc_acm_uart0 {
        compatible = "zephyr,cdc-acm-uart";
    };
};
```

## src/ECDHA_implementation.c
```c
#include "ECDHA_implementation.h"

#include <errno.h>
#include <stdio.h>
#include <stdlib.h>
#include <string.h>

#include <zephyr/kernel.h>

static const uint32_t curve_p = 9739U;
static const uint32_t curve_a = 497U;
static const uint32_t curve_b = 1768U;
static const ecdha_point_t curve_base_point =
{
        .x = 1804U,
        .y = 5368U,
        .infinity = false,
};

static uint32_t mod_add(uint32_t lhs, uint32_t rhs)
{
    return (uint32_t)(((uint64_t) lhs + (uint64_t) rhs) % curve_p);
}

static uint32_t mod_sub(uint32_t lhs, uint32_t rhs)
{
    return (uint32_t)(((uint64_t) lhs + curve_p - (rhs % curve_p)) % curve_p);
}

static uint32_t mod_mul(uint32_t lhs, uint32_t rhs)
{
    return (uint32_t)(((uint64_t) lhs * (uint64_t) rhs) % curve_p);
}

static int32_t mod_inverse(int32_t value)
{
    int32_t t = 0;
    int32_t new_t = 1;
    int32_t r = (int32_t) curve_p;
    int32_t new_r = value % (int32_t) curve_p;

    if (new_r < 0)
    {
        new_r += (int32_t) curve_p;
    }

    while (new_r != 0)
    {
        int32_t quotient = r / new_r;
        int32_t temp_t = t - quotient * new_t;
        int32_t temp_r = r - quotient * new_r;

        t = new_t;
        new_t = temp_t;
        r = new_r;
        new_r = temp_r;
    }

    if (r > 1)
    {
        return -1;
    }

    if (t < 0)
    {
        t += (int32_t) curve_p;
    }

    return t;
}

static bool point_is_infinity(const ecdha_point_t *point)
{
    return point == NULL || point->infinity;
}

static bool point_is_on_curve(const ecdha_point_t *point)
{
    uint32_t lhs;
    uint32_t rhs;

    if (point == NULL || point->infinity)
    {
        return false;
    }

    lhs = mod_mul(point->y, point->y);
    rhs = mod_add(mod_add(mod_mul(mod_mul(point->x, point->x), point->x), mod_mul(curve_a, point->x)), curve_b);

    return lhs == rhs;
}

static ecdha_point_t point_add(const ecdha_point_t *lhs, const ecdha_point_t *rhs)
{
    ecdha_point_t result = {
            .x = 0U,
            .y = 0U,
            .infinity = true,
    };

    if (point_is_infinity(lhs))
    {
        return *rhs;
    }

    if (point_is_infinity(rhs))
    {
        return *lhs;
    }

    if (lhs->x == rhs->x && lhs->y != rhs->y)
    {
        return result;
    }

    if (lhs->x == rhs->x && lhs->y == rhs->y)
    {
        if (lhs->y == 0U)
        {
            return result;
        }

        uint32_t numerator = mod_add(mod_mul(3U, mod_mul(lhs->x, lhs->x)), curve_a);
        int32_t inverse = mod_inverse((int32_t) mod_mul(2U, lhs->y));

        if (inverse < 0)
        {
            return result;
        }

        uint32_t slope = mod_mul(numerator, (uint32_t) inverse);
        uint32_t x3 = mod_sub(mod_sub(mod_mul(slope, slope), lhs->x), rhs->x);
        uint32_t y3 = mod_sub(mod_mul(slope, mod_sub(lhs->x, x3)), lhs->y);

        result.x = x3;
        result.y = y3;
        result.infinity = false;
        return result;
    }

    {
        uint32_t numerator = mod_sub(rhs->y, lhs->y);
        int32_t inverse = mod_inverse((int32_t) mod_sub(rhs->x, lhs->x));

        if (inverse < 0)
        {
            return result;
        }

        uint32_t slope = mod_mul(numerator, (uint32_t) inverse);
        uint32_t x3 = mod_sub(mod_sub(mod_mul(slope, slope), lhs->x), rhs->x);
        uint32_t y3 = mod_sub(mod_mul(slope, mod_sub(lhs->x, x3)), lhs->y);

        result.x = x3;
        result.y = y3;
        result.infinity = false;
        return result;
    }
}

static ecdha_point_t point_scalar_mul(uint32_t scalar, const ecdha_point_t *point)
{
    ecdha_point_t result = {
            .x = 0U,
            .y = 0U,
            .infinity = true,
    };
    ecdha_point_t addend = *point;

    while (scalar != 0U)
    {
        if ((scalar & 1U) != 0U)
        {
            result = point_add(&result, &addend);
        }

        addend = point_add(&addend, &addend);
        scalar >>= 1U;
    }

    return result;
}

static uint32_t mix_seed(uint32_t seed)
{
    seed ^= seed << 13U;
    seed ^= seed >> 17U;
    seed ^= seed << 5U;
    return seed;
}

const char *ecdha_curve_name(void)
{
    return "toy-ecdh-y2=x3+497x+1768(mod9739)";
}

int ecdha_generate_keypair(ecdha_keypair_t *keypair)
{
    uint32_t seed;
    uint32_t scalar;

    if (keypair == NULL)
    {
        return -EINVAL;
    }

    seed = (uint32_t) k_uptime_get_32();
    seed ^= k_cycle_get_32();
    seed = mix_seed(seed ^ 0xA5A5A5A5U);
    scalar = (seed % 4094U) + 2U;

    for (int attempt = 0; attempt < 32; attempt++)
    {
        keypair->private_scalar = scalar;
        keypair->public_key = point_scalar_mul(scalar, &curve_base_point);

        if (!point_is_infinity(&keypair->public_key))
        {
            return 0;
        }

        scalar = ((scalar + 1U) % 4094U) + 2U;
    }

    return -EIO;
}

int ecdha_public_key_to_string(const ecdha_point_t *point, char *out, size_t out_size)
{
    if (point == NULL || out == NULL || out_size == 0U)
    {
        return -EINVAL;
    }

    if (point->infinity)
    {
        return snprintf(out, out_size, "INF") < 0 ? -EIO : 0;
    }

    if (snprintf(out, out_size, "%lu,%lu",
            (unsigned long) point->x,
            (unsigned long) point->y) >= (int) out_size)
    {
        return -ENOSPC;
    }

    return 0;
}

int ecdha_public_key_from_string(const char *text, ecdha_point_t *point)
{
    unsigned long x;
    unsigned long y;

    if (text == NULL || point == NULL)
    {
        return -EINVAL;
    }

    if (strcmp(text, "INF") == 0)
    {
        point->x = 0U;
        point->y = 0U;
        point->infinity = true;
        return 0;
    }

    if (sscanf(text, "%lu,%lu", &x, &y) != 2)
    {
        return -EINVAL;
    }

    point->x = (uint32_t) x;
    point->y = (uint32_t) y;
    point->infinity = false;

    if (!point_is_on_curve(point))
    {
        return -EINVAL;
    }

    return 0;
}

int ecdha_compute_shared_secret(const ecdha_keypair_t *keypair,
                                const ecdha_point_t *peer_public_key,
                                ecdha_shared_secret_t *shared_secret)
{
    ecdha_point_t secret_point;

    if (keypair == NULL || peer_public_key == NULL || shared_secret == NULL)
    {
        return -EINVAL;
    }

    if (!point_is_on_curve(peer_public_key))
    {
        return -EINVAL;
    }

    secret_point = point_scalar_mul(keypair->private_scalar, peer_public_key);
    if (point_is_infinity(&secret_point))
    {
        return -EIO;
    }

    shared_secret->value = secret_point.x;
    return 0;
}

int ecdha_shared_secret_to_string(const ecdha_shared_secret_t *shared_secret,
                                  char *out,
                                  size_t out_size)
{
    if (shared_secret == NULL || out == NULL || out_size == 0U)
    {
        return -EINVAL;
    }

    if (snprintf(out, out_size, "%lu", (unsigned long) shared_secret->value) >= (int) out_size)
    {
        return -ENOSPC;
    }

    return 0;
}
```

## src/ECDHA_implementation.h
```c
#ifndef ECDHA_IMPLEMENTATION_H
#define ECDHA_IMPLEMENTATION_H

#include <stdbool.h>
#include <stddef.h>
#include <stdint.h>

#define ECDHA_POINT_TEXT_SIZE 32
#define ECDHA_SHARED_SECRET_TEXT_SIZE 32

typedef struct
{
    uint32_t x;
    uint32_t y;
    bool infinity;
} ecdha_point_t;

typedef struct
{
    uint32_t private_scalar;
    ecdha_point_t public_key;
} ecdha_keypair_t;

typedef struct
{
    uint32_t value;
} ecdha_shared_secret_t;

/**
 * @brief Generate a new ECDH keypair.
 *
 * Produces a private scalar and the corresponding public point.
 *
 * @param [out] keypair Destination keypair structure to populate.
 * @return 0 on success or a negative errno value on failure.
 */
int ecdha_generate_keypair(ecdha_keypair_t *keypair);

/**
 * @brief Serialize a public point into a textual representation.
 *
 * The output is placed into `out` as a NUL-terminated string if the buffer
 * is large enough.
 *
 * @param [in] point Public point to serialize.
 * @param [out] out Destination buffer for text.
 * @param [in] out_size Size of the destination buffer.
 * @return 0 on success or a negative errno value on failure.
 */
int ecdha_public_key_to_string(const ecdha_point_t *point, char *out, size_t out_size);

/**
 * @brief Parse a textual public key representation into a point structure.
 *
 * @param [in] text Textual representation to parse.
 * @param [out] point Destination point structure.
 * @return 0 on success or a negative errno value on parse error.
 */
int ecdha_public_key_from_string(const char *text, ecdha_point_t *point);

/**
 * @brief Compute the shared secret given our keypair and the peer's public key.
 *
 * The result is written into `shared_secret`.
 *
 * @param [in] keypair Our keypair (contains private scalar).
 * @param [in] peer_public_key The peer's public point.
 * @param [out] shared_secret Destination shared-secret structure.
 * @return 0 on success or a negative errno value on failure.
 */
int ecdha_compute_shared_secret(const ecdha_keypair_t *keypair,
                                const ecdha_point_t *peer_public_key,
                                ecdha_shared_secret_t *shared_secret);

/**
 * @brief Convert a shared secret to a textual representation.
 *
 * Writes a NUL-terminated string into `out` when the buffer is large enough.
 *
 * @param [in] shared_secret Shared secret to convert.
 * @param [out] out Destination buffer for textual data.
 * @param [in] out_size Size of the destination buffer.
 * @return 0 on success or negative errno on failure.
 */
int ecdha_shared_secret_to_string(const ecdha_shared_secret_t *shared_secret,
                                  char *out,
                                  size_t out_size);

/**
 * @brief Return the name of the elliptic curve used by this implementation.
 *
 * @return Pointer to a static, NUL-terminated string with the curve name.
 */
const char *ecdha_curve_name(void);

#endif
```

## src/Fips203_dispatch.c
```c
#include "Fips203_implementation.h"

/**
 * @brief Compile-time dispatch for the FIPS203 backend.
 *
 * The CMake-selected macro chooses either the mock implementation or the real
 * ML-KEM bridge without adding runtime branching to the test flow.
 */

// C-linkage prototypes for the two backend implementations. 
extern int fips203_real_keygen(const uint8_t seed_d[FIPS203_SEED_D_BYTE_LEN],
                               const uint8_t seed_z[FIPS203_SEED_Z_BYTE_LEN],
                               fips203_public_key_t *pubkey,
                               fips203_secret_key_t *seckey);

extern int fips203_real_encapsulate(const uint8_t seed_m[FIPS203_SEED_M_BYTE_LEN],
                                    const fips203_public_key_t *pubkey,
                                    fips203_cipher_text_t *ciphertext,
                                    fips203_shared_secret_t *shared_secret);

extern int fips203_real_decapsulate(const fips203_secret_key_t *seckey,
                                    const fips203_cipher_text_t *ciphertext,
                                    fips203_shared_secret_t *shared_secret);

extern int fips203_mock_keygen(const uint8_t seed_d[FIPS203_SEED_D_BYTE_LEN],
                               const uint8_t seed_z[FIPS203_SEED_Z_BYTE_LEN],
                               fips203_public_key_t *pubkey,
                               fips203_secret_key_t *seckey);

extern int fips203_mock_encapsulate(const uint8_t seed_m[FIPS203_SEED_M_BYTE_LEN],
                                    const fips203_public_key_t *pubkey,
                                    fips203_cipher_text_t *ciphertext,
                                    fips203_shared_secret_t *shared_secret);

extern int fips203_mock_decapsulate(const fips203_secret_key_t *seckey,
                                    const fips203_cipher_text_t *ciphertext,
                                    fips203_shared_secret_t *shared_secret);

// Public API selection based on the build-time backend choice. 
#ifndef USE_FIPS203_MOCK
#define USE_FIPS203_MOCK 0
#endif

#if USE_FIPS203_MOCK
int fips203_keygen(const uint8_t seed_d[FIPS203_SEED_D_BYTE_LEN],
                   const uint8_t seed_z[FIPS203_SEED_Z_BYTE_LEN],
                   fips203_public_key_t *pubkey,
                   fips203_secret_key_t *seckey)
{
    // Route key generation to the selected backend. 
    return fips203_mock_keygen(seed_d, seed_z, pubkey, seckey);
}

int fips203_encapsulate(const uint8_t seed_m[FIPS203_SEED_M_BYTE_LEN],
                        const fips203_public_key_t *pubkey,
                        fips203_cipher_text_t *ciphertext,
                        fips203_shared_secret_t *shared_secret)
{
    // Route encapsulation to the selected backend. 
    return fips203_mock_encapsulate(seed_m, pubkey, ciphertext, shared_secret);
}

int fips203_decapsulate(const fips203_secret_key_t *seckey,
                        const fips203_cipher_text_t *ciphertext,
                        fips203_shared_secret_t *shared_secret)
{
    // Route decapsulation to the selected backend. 
    return fips203_mock_decapsulate(seckey, ciphertext, shared_secret);
}
#else

int fips203_keygen(const uint8_t seed_d[FIPS203_SEED_D_BYTE_LEN],
                   const uint8_t seed_z[FIPS203_SEED_Z_BYTE_LEN],
                   fips203_public_key_t *pubkey,
                   fips203_secret_key_t *seckey)
{
    // Route key generation to the selected backend. 
    return fips203_real_keygen(seed_d, seed_z, pubkey, seckey);
}

int fips203_encapsulate(const uint8_t seed_m[FIPS203_SEED_M_BYTE_LEN],
                        const fips203_public_key_t *pubkey,
                        fips203_cipher_text_t *ciphertext,
                        fips203_shared_secret_t *shared_secret)
{
    // Route encapsulation to the selected backend. 
    return fips203_real_encapsulate(seed_m, pubkey, ciphertext, shared_secret);
}

int fips203_decapsulate(const fips203_secret_key_t *seckey,
                        const fips203_cipher_text_t *ciphertext,
                        fips203_shared_secret_t *shared_secret)
{
    // Route decapsulation to the selected backend. 
    return fips203_real_decapsulate(seckey, ciphertext, shared_secret);
}

#endif
```

## src/Fips203_implementation.c
```c
#include "Fips203_implementation.h"
#include <errno.h>
#include <stdio.h>
#include <string.h>

/**
 * @brief Blend one byte with a salt for deterministic mock output.
 *
 * @param [in] value Input byte.
 * @param [in] salt Salt byte used to vary the output.
 * @return Mixed byte value.
 */
static uint8_t mix_byte(uint8_t value, uint8_t salt)
{
    uint8_t mixed = (uint8_t)(value ^ salt);
    mixed = (uint8_t)((mixed << 3) | (mixed >> 5));
    return (uint8_t)(mixed + 0x5Du);
}

/**
 * @brief Build a deterministic mock FIPS203 key pair.
 *
 * @param [in] seed_d Deterministic private-key seed.
 * @param [in] seed_z Deterministic public-key seed.
 * @param [out] pubkey Destination public key buffer.
 * @param [out] seckey Destination secret key buffer.
 * @return 0 on success or a negative errno value on failure.
 */
int fips203_mock_keygen(const uint8_t seed_d[FIPS203_SEED_D_BYTE_LEN],
                        const uint8_t seed_z[FIPS203_SEED_Z_BYTE_LEN],
                        fips203_public_key_t *pubkey,
                        fips203_secret_key_t *seckey)
{
    size_t index;

    if (seed_d == NULL || seed_z == NULL || pubkey == NULL || seckey == NULL)
    {
        return -EINVAL;
    }

    // Build the public key by mixing the two seeds together in a deterministic way.
    for (index = 0; index < FIPS203_PKEY_BYTE_LEN; index++)
    {
        uint8_t d = seed_d[index % FIPS203_SEED_D_BYTE_LEN];
        uint8_t z = seed_z[index % FIPS203_SEED_Z_BYTE_LEN];
        pubkey->data[index] = mix_byte((uint8_t)(d + (uint8_t) index), z);
    }

    // Build the secret key by embedding the seeds and public key, then filling the rest with mixed values.
    memset(seckey->data, 0, sizeof(seckey->data));
    memcpy(seckey->data, seed_d, FIPS203_SEED_D_BYTE_LEN);
    memcpy(seckey->data + FIPS203_SEED_D_BYTE_LEN, seed_z, FIPS203_SEED_Z_BYTE_LEN);
    memcpy(seckey->data + 64, pubkey->data, FIPS203_PKEY_BYTE_LEN);

    // Fill the remaining bytes of the secret key with a mix of the seeds and public key for deterministic content.
    for (index = 64 + FIPS203_PKEY_BYTE_LEN; index < FIPS203_SKEY_BYTE_LEN; index++)
    {
        uint8_t base = seckey->data[index % 64];
        seckey->data[index] = mix_byte(base, (uint8_t) index);
    }

    return 0;
}

/**
 * @brief Build a deterministic mock encapsulation result.
 *
 * @param [in] seed_m Deterministic message seed.
 * @param [in] pubkey Public key to encapsulate against.
 * @param [out] cipher Destination ciphertext buffer.
 * @param [out] shared_secret Destination shared secret buffer.
 * @return 0 on success or a negative errno value on failure.
 */
int fips203_mock_encapsulate(const uint8_t seed_m[FIPS203_SEED_M_BYTE_LEN],
                             const fips203_public_key_t *pubkey,
                             fips203_cipher_text_t *cipher,
                             fips203_shared_secret_t *shared_secret)
{
    size_t index;

    if (seed_m == NULL || pubkey == NULL || cipher == NULL || shared_secret == NULL)
    {
        return -EINVAL;
    }

    // Build the ciphertext by mixing the message seed with the public key in a deterministic way.
    for (index = 0; index < FIPS203_CIPHER_TEXT_BYTE_LEN; index++)
    {
        uint8_t m = seed_m[index % FIPS203_SEED_M_BYTE_LEN];
        uint8_t p = pubkey->data[index % FIPS203_PKEY_BYTE_LEN];
        cipher->data[index] = (uint8_t)(m ^ p);
    }

    // Build the shared secret by further mixing the message seed with the public key.
    for (index = 0; index < FIPS203_SHARED_SECRET_BYTE_LEN; index++)
    {
        uint8_t m = seed_m[index];
        uint8_t p = pubkey->data[index];
        shared_secret->data[index] = mix_byte((uint8_t)(m ^ p), (uint8_t)(index * 11u + 7u));
    }

    return 0;
}

/**
 * @brief Recover the mock shared secret from a ciphertext.
 *
 * @param [in] seckey Secret key used for decapsulation.
 * @param [in] cipher Ciphertext received from the peer.
 * @param [out] shared_secret Destination shared secret buffer.
 * @return 0 on success or a negative errno value on failure.
 */
int fips203_mock_decapsulate(const fips203_secret_key_t *seckey,
                             const fips203_cipher_text_t *cipher,
                             fips203_shared_secret_t *shared_secret)
{
    size_t index;
    uint8_t recovered_m[FIPS203_SEED_M_BYTE_LEN];
    const uint8_t *pubkey_in_seckey;

    if (seckey == NULL || cipher == NULL || shared_secret == NULL)
    {
        return -EINVAL;
    }

    pubkey_in_seckey = seckey->data + 64;

    for (index = 0; index < FIPS203_SEED_M_BYTE_LEN; index++)
    {
        recovered_m[index] = (uint8_t)(cipher->data[index] ^ pubkey_in_seckey[index]);
    }

    // Reconstruct the shared secret using the recovered message and the public key from the secret key.
    for (index = 0; index < FIPS203_SHARED_SECRET_BYTE_LEN; index++)
    {
        uint8_t m = recovered_m[index];
        uint8_t p = pubkey_in_seckey[index];
        shared_secret->data[index] = mix_byte((uint8_t)(m ^ p), (uint8_t)(index * 11u + 7u));
    }

    return 0;
}

int fips203_shared_secret_to_string(const fips203_shared_secret_t *shared_secret,
                                    char *out,
                                    size_t out_size)
{
    size_t index;
    int written;

    if (shared_secret == NULL || out == NULL)
    {
        return -EINVAL;
    }

    if (out_size < (FIPS203_SHARED_SECRET_BYTE_LEN * 2u + 1u))
    {
        return -ENOSPC;
    }

    for (index = 0; index < FIPS203_SHARED_SECRET_BYTE_LEN; index++)
    {
        written = snprintf(out + (index * 2u), out_size - (index * 2u), "%02X", shared_secret->data[index]);
        if (written != 2)
        {
            return -EINVAL;
        }
    }

    out[FIPS203_SHARED_SECRET_BYTE_LEN * 2u] = '\0';
    return 0;
}
```

## src/Fips203_implementation.cpp
```c
#include "Fips203_implementation.h"
#include "ml_kem/ml_kem_768.hpp"
#include <span>

extern "C" {

/**
 * @brief Generate a ML-KEM-768 key pair. (not Mock)
 *
 * Bridges the C API to the C++ implementation used for the production path.
 *
 * @param [in] seed_d Deterministic private-key seed.
 * @param [in] seed_z Deterministic public-key seed.
 * @param [out] pubkey Destination public key buffer.
 * @param [out] seckey Destination secret key buffer.
 * @return 0 on success or -1 on invalid input.
 */
int fips203_real_keygen(const uint8_t seed_d[FIPS203_SEED_D_BYTE_LEN],
                        const uint8_t seed_z[FIPS203_SEED_Z_BYTE_LEN],
                        fips203_public_key_t *pubkey,
                        fips203_secret_key_t *seckey)
{
    if (!seed_d || !seed_z || !pubkey || !seckey) return -1;
    ml_kem_768::keygen(
            std::span<const uint8_t, 32>(seed_d, 32),
            std::span<const uint8_t, 32>(seed_z, 32),
            std::span<uint8_t, 1184>(pubkey->data, 1184),
            std::span<uint8_t, 2400>(seckey->data, 2400)
    );
    return 0;
}

/**
 * @brief Encapsulate against a ML-KEM-768 public key.
 *
 * @param [in] seed_m Deterministic message seed.
 * @param [in] pubkey Public key to encapsulate against.
 * @param [out] ciphertext Destination ciphertext buffer.
 * @param [out] shared_secret Destination shared secret buffer.
 * @return 0 on success or -1 on invalid input / encapsulation failure.
 */
int fips203_real_encapsulate(const uint8_t seed_m[FIPS203_SEED_M_BYTE_LEN],
                             const fips203_public_key_t *pubkey,
                             fips203_cipher_text_t *ciphertext,
                             fips203_shared_secret_t *shared_secret)
{
    if (!seed_m || !pubkey || !ciphertext || !shared_secret) return -1;
    bool success = ml_kem_768::encapsulate(
            std::span<const uint8_t, 32>(seed_m, 32),
            std::span<const uint8_t, 1184>(pubkey->data, 1184),
            std::span<uint8_t, 1088>(ciphertext->data, 1088),
            std::span<uint8_t, 32>(shared_secret->data, 32)
    );
    return success ? 0 : -1;
}

/**
 * @brief Decapsulate a ML-KEM-768 ciphertext.
 *
 * @param [in] seckey Secret key used for decapsulation.
 * @param [in] ciphertext Ciphertext received from the peer.
 * @param [out] shared_secret Destination shared secret buffer.
 * @return 0 on success or -1 on invalid input.
 */
int fips203_real_decapsulate(const fips203_secret_key_t *seckey,
                             const fips203_cipher_text_t *ciphertext,
                             fips203_shared_secret_t *shared_secret)
{
    if (!ciphertext || !seckey || !shared_secret) return -1;
    ml_kem_768::decapsulate(
            std::span<const uint8_t, 2400>(seckey->data, 2400),
            std::span<const uint8_t, 1088>(ciphertext->data, 1088),
            std::span<uint8_t, 32>(shared_secret->data, 32)
    );
    return 0;
}

}
```

## src/Fips203_implementation.h
```c
#ifndef FIPS203_IMPLEMENTATION_H
#define FIPS203_IMPLEMENTATION_H

#ifdef __cplusplus
extern "C" {
#endif

#include <stdint.h>
#include <stddef.h>
#include <stdbool.h>

/* ML-KEM-768 Constants */
#define FIPS203_SEED_D_BYTE_LEN 32
#define FIPS203_SEED_Z_BYTE_LEN 32
#define FIPS203_PKEY_BYTE_LEN 1184
#define FIPS203_SKEY_BYTE_LEN 2400
#define FIPS203_SEED_M_BYTE_LEN 32
#define FIPS203_CIPHER_TEXT_BYTE_LEN 1088
#define FIPS203_SHARED_SECRET_BYTE_LEN 32

/* ML-KEM-768 Key Types */
typedef struct
{
    uint8_t data[FIPS203_PKEY_BYTE_LEN];
} fips203_public_key_t;

typedef struct
{
    uint8_t data[FIPS203_SKEY_BYTE_LEN];
} fips203_secret_key_t;

typedef struct
{
    uint8_t data[FIPS203_CIPHER_TEXT_BYTE_LEN];
} fips203_cipher_text_t;

typedef struct
{
    uint8_t data[FIPS203_SHARED_SECRET_BYTE_LEN];
} fips203_shared_secret_t;

/**
 * @brief Generate a FIPS203 key pair.
 *
 * @param [in] seed_d Deterministic seed used for the private key path.
 * @param [in] seed_z Deterministic seed used for the public key path.
 * @param [out] pubkey Destination public key buffer.
 * @param [out] seckey Destination secret key buffer.
 * @return 0 on success or a negative errno value on failure.
 */
int fips203_keygen(const uint8_t seed_d[FIPS203_SEED_D_BYTE_LEN],
                   const uint8_t seed_z[FIPS203_SEED_Z_BYTE_LEN],
                   fips203_public_key_t *pubkey,
                   fips203_secret_key_t *seckey);

/**
 * @brief Encapsulate to a FIPS203 public key.
 *
 * @param [in] seed_m Deterministic message seed used for the encapsulation.
 * @param [in] pubkey Public key to encapsulate against.
 * @param [out] cipher Destination ciphertext buffer.
 * @param [out] shared_secret Destination shared secret buffer.
 * @return 0 on success or a negative errno value on failure.
 */
int fips203_encapsulate(const uint8_t seed_m[FIPS203_SEED_M_BYTE_LEN],
                        const fips203_public_key_t *pubkey,
                        fips203_cipher_text_t *cipher,
                        fips203_shared_secret_t *shared_secret);

/**
 * @brief Decapsulate a FIPS203 ciphertext.
 *
 * @param [in] seckey Secret key used for decapsulation.
 * @param [in] cipher Ciphertext received from the peer.
 * @param [out] shared_secret Destination shared secret buffer.
 * @return 0 on success or a negative errno value on failure.
 */
int fips203_decapsulate(const fips203_secret_key_t *seckey,
                        const fips203_cipher_text_t *cipher,
                        fips203_shared_secret_t *shared_secret);

/**
 * @brief Convert a FIPS203 shared secret to a hex/text string.
 *
 * Formats the `shared_secret` bytes into a human-readable textual
 * representation placed into `out`. The output is NUL-terminated when the
 * provided buffer is large enough.
 *
 * @param [in] shared_secret Pointer to the shared secret to format.
 * @param [out] out Destination buffer for the textual representation.
 * @param [in] out_size Size of the destination buffer in bytes.
 * @return 0 on success or a negative errno value if `out_size` is too small.
 */
int fips203_shared_secret_to_string(const fips203_shared_secret_t *shared_secret,
                                    char *out, size_t out_size);

#ifdef __cplusplus
}
#endif

#endif
```

## src/user_usb.h
```c
#ifndef USER_USB_H_
#define USER_USB_H_

#include <stddef.h>
#include <stdint.h>
#include <stdbool.h>
#include <zephyr/kernel.h>

/**
 * @brief Initialize the USB transport layer.
 *
 * Sets up the CDC/ACM path and prepares the helper layer for later sends and
 * receives.
 *
 * @return 0 on success or a negative errno value on failure.
 */
int usb_init(void);

/**
 * @brief Check whether the host connection is active.
 *
 * @return True when the USB DTR state is asserted, otherwise false.
 */
bool usb_is_connected(void);

/**
 * @brief Send a raw byte buffer through USB.
 *
 * @param [in] data Byte buffer to transmit.
 * @param [in] len Number of bytes to send.
 * @return Number of bytes written on success or a negative errno value.
 */
int user_usb_send(const uint8_t *data, size_t len);

/**
 * @brief Send a null-terminated string through USB.
 *
 * @param [in] str Text to transmit.
 * @return 0 or a positive byte count on success, negative errno on failure.
 */
int usb_send_str(const char *str);

/**
 * @brief Send a human-readable tagged line.
 *
 * @param [in] tag Short category prefix.
 * @param [in] message Message body to transmit.
 * @return 0 on success or a negative errno value on failure.
 */
int usb_send_text_line(const char *tag, const char *message);

/**
 * @brief Send a labeled 32-bit unsigned integer as a key/value pair.
 *
 * The helper formats the label and value in a stable textual representation
 * suitable for logging over the USB transport.
 *
 * @param [in] label Short textual key identifying the value.
 * @param [in] value 32-bit unsigned integer to transmit.
 * @return 0 on success or a negative errno value on failure.
 */
int usb_send_kv_u32(const char *label, uint32_t value);

/**
 * @brief Send a raw C-string as data over USB.
 *
 * Convenience wrapper that transmits the nul-terminated `data` buffer.
 *
 * @param [in] data NUL-terminated string to send.
 * @return 0 on success or a negative errno value on failure.
 */
int usb_send_data(const char *data);

/**
 * @brief Send a log record with the standard USB log prefix.
 *
 * @param [in] log Log message text.
 * @return 0 on success or a negative errno value on failure.
 */
int usb_send_log(const char *log);

/**
 * @brief Send comma-separated values (CSV) text over USB.
 *
 * Used for machine-parsable measurements and bench output.
 *
 * @param [in] csv_data CSV line to transmit (NUL-terminated).
 * @return 0 on success or a negative errno value on failure.
 */
int usb_send_csv(const char *csv_data);

/**
 * @brief Try to read available bytes from the USB receive buffer without blocking.
 *
 * Copies up to `out_size` bytes into `out`. If no data is available the
 * function returns immediately with an appropriate status code.
 *
 * @param [out] out Destination buffer for received bytes.
 * @param [in] out_size Size of the destination buffer in bytes.
 * @param [out] out_len Number of bytes written into `out` on success.
 * @return 0 on success, 0 with `out_len==0` if no data available, or a negative
 * errno value on error.
 */
int usb_receive_try(uint8_t *out, size_t out_size, size_t *out_len);

/**
 * @brief Wait for one buffered USB line.
 *
 * @param [out] out Destination buffer.
 * @param [in] out_size Destination buffer size in bytes.
 * @param [out] out_len Number of bytes copied into out.
 * @param [in] timeout Maximum wait duration.
 * @return 0 on success or a negative errno value on failure / timeout.
 */
int usb_receive_wait(uint8_t *out,
                     size_t out_size,
                     size_t *out_len,
                     k_timeout_t timeout);

/**
 * @brief Entry point for the USB worker thread.
 *
 * This function conforms to the Zephyr thread entry prototype and is used to
 * run the USB processing loop when the worker thread is started.
 *
 * @param p1 Unused; reserved for Zephyr thread API.
 * @param p2 Unused; reserved for Zephyr thread API.
 * @param p3 Unused; reserved for Zephyr thread API.
 */
void usb_entry(void *p1, void *p2, void *p3);

#endif /* USER_USB_H_ */
```
