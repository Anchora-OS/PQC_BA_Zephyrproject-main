## CMakeLists.txt
```
cmake_minimum_required(VERSION 3.20.0)

set(BOARD_ROOT "${CMAKE_CURRENT_SOURCE_DIR}/..//../")
set(BOARD "mc1board")
set(BOARD_FLASH_RUNNER "jlink")
set(BOARD_DEBUG_RUNNER "jlink")

find_package(Zephyr REQUIRED HINTS $ENV{ZEPHYR_BASE})
project(FIPS204_Implementation LANGUAGES C CXX)

target_link_libraries(app PRIVATE mbedTLS)

# Allow extended constexpr evaluation for ML-DSA precomputed tables (GCC only)
target_compile_options(app PRIVATE
    -fconstexpr-ops-limit=1000000000
)

# Add source files
target_sources(app PRIVATE
    src/main.cpp
    src/FiPS204_implementation.cpp
    src/USBcommunication.cpp
    src/ECDSA_implementation.cpp
)

# Add include directories
target_include_directories(app PRIVATE
    src/
    src/ml_dsa/
)
```

## prj.conf
```kconfig
## Configure memory
CONFIG_MAIN_STACK_SIZE=131072
CONFIG_CPP=y
CONFIG_STD_CPP20=y
CONFIG_GLIBCXX_LIBCPP=y


#CONFIG_THREAD_STACK_INFO=y
CONFIG_THREAD_STACK_INFO=y
CONFIG_INIT_STACKS=y
#CONFIG_THREAD_ANALYZER=y
#CONFIG_THREAD_ANALYZER_AUTO=y
CONFIG_SYS_HEAP_RUNTIME_STATS=y
CONFIG_NEWLIB_LIBC=y
#CONFIG_HEAP_MEM_POOL_SIZE=16384

## configure RSA Math functions
CONFIG_MBEDTLS=y
CONFIG_MBEDTLS_BUILTIN=y
CONFIG_MBEDTLS_CTR_DRBG_C=y
CONFIG_MBEDTLS_ENTROPY_C=y
#CONFIG_MBEDTLS_RSA_C=y
#CONFIG_MBEDTLS_SHA256=y
#CONFIG_MBEDTLS_PKCS1_V21=y   # PSS + OAEP
CONFIG_MBEDTLS_CIPHER_AES_ENABLED=y
#CONFIG_MBEDTLS_BIGNUM=y

## configure Functions for ECDSA algo
CONFIG_MBEDTLS_ECP_C=y
CONFIG_MBEDTLS_ECDSA_C=y
CONFIG_MBEDTLS_ECDH_C=y
CONFIG_MBEDTLS_SHA256=y
CONFIG_MBEDTLS_ASN1_PARSE_C=y
#CONFIG_MBEDTLS_ASN1_WRITE_C=y
CONFIG_MBEDTLS_ECP_DP_SECP256R1_ENABLED=y

#CONFIG_MBEDTLS_GENPRIME_ENABLED=y
#CONFIG_ENTROPY=y
#CONFIG_ENTROPY_STM32=y
CONFIG_ENTROPY_GENERATOR=y


## Configure Power Management
#CONFIG_PM=y

## Configure USB peripheral

CONFIG_USB_DEVICE_STACK_NEXT=y
CONFIG_USB_CDC_ACM=n
CONFIG_USB_DEVICE_STACK=n

# Enable USB device support
#CONFIG_USBD=y

# Enable CDC ACM class (NEW API)
#CONFIG_USBD_CDC_ACM=y

# Initialize automatically
#CONFIG_USBD_CDC_ACM_INIT_AT_BOOT=y
CONFIG_CDC_ACM_SERIAL_INITIALIZE_AT_BOOT=y

# Optional descriptors
#CONFIG_USBD_MANUFACTURER="USB_Debugger_PQC_Implementation"
#CONFIG_USBD_PRODUCT="Zephyr USB"
## Configure GPIO
CONFIG_GPIO=y

## Configure SPI
CONFIG_SPI=n
CONFIG_SPI_STM32=n
CONFIG_DMA=n
CONFIG_SPI_STM32_DMA=n

## Configure PWM
CONFIG_PWM=n
CONFIG_PWM_STM32=n
CONFIG_PINCTRL=y

## Activate serial console
CONFIG_SERIAL=y
CONFIG_CONSOLE=y
CONFIG_UART_CONSOLE=y
#CONFIG_USB_UART_CONSOLE=n
#CONFIG_STDOUT_CONSOLE=y
#CONFIG_UART_LINE_CTRL=y

## Configure Logging
CONFIG_LOG=y
CONFIG_LOG_PRINTK=n
CONFIG_LOG_DEFAULT_LEVEL=3
CONFIG_LOG_MODE_DEFERRED=y

## Enable SEGGER RTT logging
CONFIG_USE_SEGGER_RTT=y
CONFIG_RTT_CONSOLE=n
CONFIG_PRINTK=y
CONFIG_LOG_BACKEND_RTT=y
CONFIG_LOG_BACKEND_RTT_MODE_BLOCK=y

## Config Events
CONFIG_EVENTS=y

## Configure Display
CONFIG_DISPLAY=n
CONFIG_FLASH=n
CONFIG_SPI=n

## Enable regulator framwork for LCD backlight
CONFIG_REGULATOR=n

## Configure LVGL
CONFIG_LVGL=n
CONFIG_LV_USE_LABEL=n
CONFIG_LV_USE_LOG=n

CONFIG_LV_COLOR_DEPTH_16=n
CONFIG_LV_FONT_MONTSERRAT_18=n
#CONFIG_LV_Z_MEM_POOL_SIZE=n
##16384
## important to swap upper and lower bytes of the pixels
CONFIG_LV_COLOR_16_SWAP=n

CONFIG_LV_USE_BUTTON=n
CONFIG_LV_USE_ARC=n
CONFIG_LV_USE_IMAGE=n

## General for Ethernet
#CONFIG_POSIX_API=n

## Networking Config
#CONFIG_NETWORKING=n
#CONFIG_NET_IPV4=n
#CONFIG_NET_IPV6=n
#CONFIG_NET_SOCKETS=n
```

## src/ECDSA_implementation.cpp
```c
#include <mbedtls/ecdsa.h>
#include <mbedtls/ecp.h>
#include <mbedtls/sha256.h>
#include <mbedtls/ctr_drbg.h>
#include <mbedtls/entropy.h>
#include <string.h>
#include <stdio.h>
#include "USBcommunication.h"
#include "ECDSA_implementation.h"


static mbedtls_entropy_context entropy;
static mbedtls_ctr_drbg_context ctr_drbg;
static int rng_initialized;

/**
 * @brief Report an mbedTLS error through the USB log.
 *
 * Converts the negative mbedTLS error code into a compact hex message so the
 * caller can see which primitive failed without changing control flow.
 *
 * @param [in] context Short label for the failing mbedTLS call.
 * @param [in] err Negative mbedTLS error code.
 * @return None.
 */
static void report_mbedtls_error(const char *context, int err)
{
    char msg[96];
    snprintf(msg, sizeof(msg), "%s failed: 0x%04X", context, (unsigned int) (-err));
    USB_print(msg);
}

/**
 * @brief Initialize the shared RNG used by the ECDSA path.
 *
 * Seeds the CTR-DRBG once and reuses it across later sign and keygen calls so
 * the ECDSA helpers can stay lightweight.
 *
 * @return int Returns 0 on success and the mbedTLS error code on failure.
 */
static int init_rng(void)
{
    int ret;

    if (rng_initialized)
    {
        return 0;
    }

    mbedtls_entropy_init(&entropy);
    mbedtls_ctr_drbg_init(&ctr_drbg);

    const char *pers = "ecdsa_demo";

    // Use a fixed personalization string so the DRBG state is tied to this
    // firmware image and not to unrelated callers.
    ret = mbedtls_ctr_drbg_seed(&ctr_drbg,
            mbedtls_entropy_func,
            &entropy,
            (const unsigned char *) pers,
            strlen(pers));

    if (ret != 0)
    {
        report_mbedtls_error("mbedtls_ctr_drbg_seed", ret);
        return ret;
    }

    rng_initialized = 1;
    return 0;
}

// ---------------- KEY GENERATION ----------------

/**
 * @brief Generate a fresh ECDSA key pair.
 *
 * Allocates the context if needed and fills it with a secp256r1 key pair for
 * the current benchmark run.
 *
 * @param [in,out] ctx ECDSA context to initialize and populate.
 * @return int Returns 0 on success and a negative value on invalid input or
 *             mbedTLS failure.
 */
int ecdsa_generate_keys(mbedtls_ecdsa_context *ctx)
{
    int ret;

    if (ctx == NULL)
    {
        USB_print("ecdsa_generate_keys: ctx NULL");
        return -1;
    }

    ret = init_rng();
    if (ret != 0) return ret;

    mbedtls_ecdsa_init(ctx);

    ret = mbedtls_ecdsa_genkey(ctx,
            MBEDTLS_ECP_DP_SECP256R1,
            mbedtls_ctr_drbg_random,
            &ctr_drbg);

    if (ret != 0)
    {
        report_mbedtls_error("mbedtls_ecdsa_genkey", ret);
        return ret;
    }

    USB_print("ECDSA keypair generated (secp256r1)");
    return 0;
}

// ---------------- SIGNING ----------------

/**
 * @brief Sign the current message buffer with the active ECDSA key.
 *
 * Hashes the raw message first so the signature input stays consistent with
 * the verify path, then writes the raw r||s signature into the output buffer.
 *
 * @param [in,out] ctx Active ECDSA context with a generated private key.
 * @param [in] message Message bytes to sign.
 * @param [in] message_len Length of the message in bytes.
 * @param [out] signature Output buffer that receives the 64-byte signature.
 * @param [out] sig_len Receives the written signature length.
 * @return int Returns 0 on success and a negative value on invalid input or
 *             mbedTLS failure.
 */
int ecdsa_sign(mbedtls_ecdsa_context *ctx,
               const unsigned char *message,
               size_t message_len,
               unsigned char *signature,
               size_t *sig_len)
{
    int ret;
    unsigned char hash[32];
    mbedtls_mpi r, s;
    size_t r_len = 0;
    size_t s_len = 0;

    if (!ctx || !message || !signature || !sig_len)
    {
        USB_print("ecdsa_sign: invalid args");
        return -1;
    }

    ret = init_rng();
    if (ret != 0) return ret;

    mbedtls_mpi_init(&r);
    mbedtls_mpi_init(&s);

    // Hash the raw message first because ECDSA operates on a digest, not the
    // original byte stream.
    mbedtls_sha256(message, message_len, hash, 0);

    // Sign the digest and keep the result in the intermediate r and s values.
    ret = mbedtls_ecdsa_sign(&ctx->MBEDTLS_PRIVATE(grp),
            &r,
            &s,
            &ctx->MBEDTLS_PRIVATE(d),
            hash,
            sizeof(hash),
            mbedtls_ctr_drbg_random,
            &ctr_drbg);

    if (ret != 0)
    {
        report_mbedtls_error("mbedtls_ecdsa_sign", ret);
        goto cleanup;
    }

    // Convert r and s into the fixed-width transport format expected by the
    // host side parser.
    r_len = mbedtls_mpi_size(&r);
    s_len = mbedtls_mpi_size(&s);

    memset(signature, 0, 64);   // Clear the output buffer before writing the variable-length r and s values.

    // Write r and s into the output buffer with leading zero padding as needed to fit the fixed 32-byte width.
    ret = mbedtls_mpi_write_binary(&r, signature + (32 - r_len), r_len);
    if (ret != 0)
    {
        report_mbedtls_error("mbedtls_mpi_write_binary(r)", ret);
        goto cleanup;
    }

    ret = mbedtls_mpi_write_binary(&s, signature + 32 + (32 - s_len), s_len);
    if (ret != 0)
    {
        report_mbedtls_error("mbedtls_mpi_write_binary(s)", ret);
        goto cleanup;
    }

    *sig_len = 64;

    cleanup:
    mbedtls_mpi_free(&r);
    mbedtls_mpi_free(&s);

    return ret;
}

// ---------------- VERIFY ----------------

/**
 * @brief Verify an ECDSA signature against the active key and message.
 *
 * Rebuilds the r and s values from the raw transport buffer, hashes the
 * message in the same way as signing, and checks the signature against the
 * public key stored in the context.
 *
 * @param [in] ctx Active ECDSA context with the public key loaded.
 * @param [in] message Message bytes to verify.
 * @param [in] message_len Length of the message in bytes.
 * @param [in] signature Raw 64-byte r||s signature buffer.
 * @param [in] sig_len Signature length in bytes.
 * @return int Returns 0 when the signature is valid and a negative value on
 *             invalid input or verification failure.
 */
int ecdsa_verify(mbedtls_ecdsa_context *ctx,
                 const unsigned char *message,
                 size_t message_len,
                 const unsigned char *signature,
                 size_t sig_len)
{
    int ret;
    unsigned char hash[32];
    mbedtls_mpi r, s;

    if (!ctx || !message || !signature)
    {
        USB_print("ecdsa_verify: invalid args");
        return -1;
    }

    if (sig_len != 64)
    {
        USB_print("ecdsa_verify: invalid signature length");
        return -1;
    }

    mbedtls_mpi_init(&r);
    mbedtls_mpi_init(&s);

    // Rebuild the signature components from the flat transport buffer.
    ret = mbedtls_mpi_read_binary(&r, signature, 32);
    if (ret != 0)
    {
        report_mbedtls_error("mbedtls_mpi_read_binary(r)", ret);
        mbedtls_mpi_free(&r);
        mbedtls_mpi_free(&s);
        return ret;
    }

    // The s value is located after r in the transport format.
    ret = mbedtls_mpi_read_binary(&s, signature + 32, 32);
    if (ret != 0)
    {
        report_mbedtls_error("mbedtls_mpi_read_binary(s)", ret);
        mbedtls_mpi_free(&r);
        mbedtls_mpi_free(&s);
        return ret;
    }

    // Hash the message the same way as the signing path.
    mbedtls_sha256(message, message_len, hash, 0);

    // Verify the digest against the public key already stored in the context.
    ret = mbedtls_ecdsa_verify(&ctx->MBEDTLS_PRIVATE(grp),
            hash,
            sizeof(hash),
            &ctx->MBEDTLS_PRIVATE(Q),
            &r,
            &s);

    if (ret != 0)
    {
        report_mbedtls_error("mbedtls_ecdsa_verify", ret);
    }

    mbedtls_mpi_free(&r);
    mbedtls_mpi_free(&s);

    return ret;
}

// ---------------- CLEANUP ----------------

/**
 * @brief Release all ECDSA and RNG state used by the module.
 *
 * Clears the key context and resets the shared RNG bookkeeping so the next run
 * starts from a clean state.
 *
 * @param [in,out] ctx ECDSA context to free.
 * @return None.
 */
void ecdsa_free(mbedtls_ecdsa_context *ctx)
{
    mbedtls_ecdsa_free(ctx);
    mbedtls_ctr_drbg_free(&ctr_drbg);
    mbedtls_entropy_free(&entropy);
    rng_initialized = 0;
}
```

## src/ECDSA_implementation.h
```c
#ifndef ECDSA_IMPLEMENTATION_H
#define ECDSA_IMPLEMENTATION_H

#include <mbedtls/ecdsa.h>
#include <stddef.h>

/**
 * @brief Generate a fresh ECDSA key pair (secp256r1).
 *
 * Initializes and populates the provided ECDSA context with a new
 * keypair. Intended for use before signing or verification operations.
 *
 * @param [in,out] ctx Pointer to an mbedtls_ecdsa_context to initialize.
 * @return int 0 on success, negative mbedTLS error code on failure.
 */
int ecdsa_generate_keys(mbedtls_ecdsa_context *ctx);

/**
 * @brief Sign a message using the active ECDSA private key.
 *
 * Hashes the input message and produces a raw 64-byte r||s signature in
 * the output buffer.
 *
 * @param [in] ctx Active ECDSA context containing the private key.
 * @param [in] message Message bytes to be signed.
 * @param [in] message_len Length of the message in bytes.
 * @param [out] signature Buffer that receives the 64-byte signature (r||s).
 * @param [out] sig_len Receives the number of written signature bytes.
 * @return int 0 on success, negative value on error.
 */
int ecdsa_sign(mbedtls_ecdsa_context *ctx,
               const unsigned char *message,
               size_t message_len,
               unsigned char *signature,
               size_t *sig_len);

/**
 * @brief Verify a 64-byte r||s signature against the given message.
 *
 * Reconstructs the r and s components from the transport format, hashes the
 * message, and verifies the signature against the public key in @p ctx.
 *
 * @param [in] ctx Active ECDSA context with the public key.
 * @param [in] message Message bytes that were signed.
 * @param [in] message_len Length of the message in bytes.
 * @param [in] signature Raw 64-byte r||s signature buffer.
 * @param [in] sig_len Length of the signature buffer (expected 64).
 * @return int 0 when the signature is valid, negative on error or invalid.
 */
int ecdsa_verify(mbedtls_ecdsa_context *ctx,
                 const unsigned char *message,
                 size_t message_len,
                 const unsigned char *signature,
                 size_t sig_len);

/**
 * @brief Free ECDSA and RNG resources associated with the context.
 *
 * Releases internal mbedTLS structures and resets any shared RNG state.
 *
 * @param [in,out] ctx Context to free; may be NULL.
 * @return void
 */
void ecdsa_free(mbedtls_ecdsa_context *ctx);

#endif // ECDSA_IMPLEMENTATION_H
```

## src/FiPS204_implementation.cpp
```c
#include "FiPS204_implementation.h"
#include <zephyr/random/random.h>
#include "ml_dsa/ml_dsa_65.hpp"
#include <array>
#include <string.h>
#include <vector>

// ---------------- CONFIG ----------------

static constexpr size_t MSG_LEN = 32;   // Fixed message length for signing and verification

// ---------------- GLOBAL STATE ----------------
// Module-local buffers to hold the current key, signature, and message for the
static std::array<uint8_t, ml_dsa_65::PubKeyByteLen> pubkey;
static std::array<uint8_t, ml_dsa_65::SecKeyByteLen> seckey;
static std::array<uint8_t, ml_dsa_65::SigByteLen> signature;

static std::array<uint8_t, MSG_LEN> message;

// ---------------- (Zephyr random) ----------------

/**
 * @brief Fill a buffer with entropy from Zephyr's random source.
 *
 * Keeps the module self-contained so the key generation and signing helpers
 * can request fresh randomness without dealing with the RNG backend directly.
 *
 * @param [out] buf Buffer to receive random bytes.
 * @param [in] len Number of bytes to fill.
 * @return None.
 */
static void fill_random(uint8_t *buf, size_t len)
{
    sys_rand_get(buf, len);
}

// ---------------- KEYGEN ----------------

/**
 * @brief Generate the ML-DSA key pair used by the current run.
 *
 * Fills a fresh seed, derives the public and secret keys, and stores them in
 * the module-local buffers for later signing and verification.
 *
 * @return int Returns 0 on success and never returns a partial result.
 */
int fips204_generate_keys(void)
{
    std::array<uint8_t, ml_dsa_65::KeygenSeedByteLen> seed{};

    // Generate a fresh seed so each benchmark run starts from a new key pair.
    fill_random(seed.data(), seed.size());

    ml_dsa_65::keygen(seed, pubkey, seckey);
    return 0;
}

// ---------------- SIGN ----------------

/**
 * @brief Sign the current ML-DSA message buffer.
 *
 * Uses a fresh per-signature randomness block and a fresh message so the
 * benchmark can measure a full sign operation instead of reusing prior state.
 *
 * @return int Returns 0 on success and -1 when the signing primitive rejects
 *             the input.
 */
int fips204_sign(void)
{
    std::array<uint8_t, ml_dsa_65::SigningSeedByteLen> rnd{};

    // Refresh both the per-signature randomness and the message buffer so the
    // signer and verifier operate on the same current-run data.
    fill_random(rnd.data(), rnd.size());
    fill_random(message.data(), message.size());

    std::vector<uint8_t> msg_vec(message.begin(), message.end());
    // Sign the message and store the result in the module-local signature buffer.
    bool ok = ml_dsa_65::sign(rnd, seckey, msg_vec, {}, signature);

    if (!ok)
    {
        return -1;
    }
    return 0;
}

// ---------------- VERIFY ----------------

/**
 * @brief Verify the stored ML-DSA signature against the stored public key.
 *
 * Rebuilds the message view from the module buffer so verification checks the
 * exact data that was just signed.
 *
 * @return int Returns 0 when the signature is valid and -1 otherwise.
 */
int fips204_verify(void)
{
    std::vector<uint8_t> msg_vec(message.begin(), message.end());

    bool valid = ml_dsa_65::verify(pubkey, msg_vec, {}, signature);

    if (!valid)
    {
        return -1;
    }
    return 0;
}

// ---------------- miscellaneous ----------------

/**
 * @brief Clear the stored ML-DSA key, signature, and message buffers.
 *
 * Resets all module-local state so the next benchmark run does not reuse data
 * from a previous pass.
 *
 * @return None.
 */
void fips204_reset_state(void)
{
    memset(pubkey.data(), 0, pubkey.size());
    memset(seckey.data(), 0, seckey.size());
    memset(signature.data(), 0, signature.size());
    memset(message.data(), 0, message.size());
}

/**
 * @brief Expose the stored ML-DSA public key buffer.
 *
 * @return const uint8_t* Pointer to the module-local public key bytes.
 */
const uint8_t *fips204_get_public_key(void)
{
    return pubkey.data();
}

/**
 * @brief Return the size of the stored ML-DSA public key.
 *
 * @return size_t Public key length in bytes.
 */
size_t fips204_get_public_key_len(void)
{
    return pubkey.size();
}

/**
 * @brief Expose the stored ML-DSA signature buffer.
 *
 * @return const uint8_t* Pointer to the module-local signature bytes.
 */
const uint8_t *fips204_get_signature(void)
{
    return signature.data();
}

/**
 * @brief Return the size of the stored ML-DSA signature.
 *
 * @return size_t Signature length in bytes.
 */
size_t fips204_get_signature_len(void)
{
    return signature.size();
}

/**
 * @brief Expose the stored ML-DSA message buffer.
 *
 * @return const uint8_t* Pointer to the module-local message bytes.
 */
const uint8_t *fips204_get_message(void)
{
    return message.data();
}

/**
 * @brief Return the size of the stored ML-DSA message.
 *
 * @return size_t Message length in bytes.
 */
size_t fips204_get_message_len(void)
{
    return message.size();
}
```

## src/FiPS204_implementation.h
```c
#ifndef FIPS204_IMPLEMENTATION_H
#define FIPS204_IMPLEMENTATION_H

#include <stddef.h>
#include <stdint.h>

/**
 * @brief Generate an ML-DSA key pair for the current run.
 *
 * Derives and stores the public and secret keys in module-local buffers.
 *
 * @return int 0 on success.
 */
int fips204_generate_keys(void);

/**
 * @brief Sign the internally-stored message using the ML-DSA secret key.
 *
 * Produces the signature in the module-local signature buffer.
 *
 * @return int 0 on success, -1 on failure.
 */
int fips204_sign(void);

/**
 * @brief Verify the stored signature against the stored public key.
 *
 * Uses the module-local message buffer as verification input.
 *
 * @return int 0 when the signature is valid, -1 otherwise.
 */
int fips204_verify(void);

/**
 * @brief Clear stored ML-DSA state (keys, signature, message).
 *
 * Resets module-local buffers so subsequent runs start from a clean state.
 */
void fips204_reset_state(void);

/**
 * @brief Return pointer to the stored ML-DSA public key.
 *
 * @return const uint8_t* Pointer to public key bytes.
 */
const uint8_t *fips204_get_public_key(void);

/**
 * @brief Return the length of the stored ML-DSA public key.
 *
 * @return size_t Public key length in bytes.
 */
size_t fips204_get_public_key_len(void);

/**
 * @brief Return pointer to the stored ML-DSA signature.
 *
 * @return const uint8_t* Pointer to signature bytes.
 */
const uint8_t *fips204_get_signature(void);

/**
 * @brief Return the length of the stored ML-DSA signature.
 *
 * @return size_t Signature length in bytes.
 */
size_t fips204_get_signature_len(void);

/**
 * @brief Return pointer to the stored ML-DSA message buffer.
 *
 * @return const uint8_t* Pointer to message bytes used for the last sign.
 */
const uint8_t *fips204_get_message(void);

/**
 * @brief Return the length of the stored ML-DSA message.
 *
 * @return size_t Message length in bytes.
 */
size_t fips204_get_message_len(void);

#endif
```

## src/USBcommunication.cpp
```c
#include <stddef.h>
#include <zephyr/kernel.h>
#include <stdint.h>
#include <zephyr/sys/printk.h>
#include "USBcommunication.h"

#define SLEEP_TIME_MS 100 // to make usb communication more stable


/**
 * @brief Send the key/signature/message payload over USB.
 *
 * Splits the combined payload into labeled sections so the host can parse and
 * verify each field separately while keeping the transfer text-based.
 * start and end markers for each field for hostside delimitation and parsing.
 *
 * @param [in] str Combined payload in the form pub@sig@msg.
 * @return None.
 */
void USB_send_key_and_signature(const char *str)
{
    k_msleep(SLEEP_TIME_MS);
    const size_t CHUNK_SIZE = 256;
    k_msleep(SLEEP_TIME_MS);

    if (str == NULL)
    {
        return;
    }

    // Locate the field separators so the payload can be split into labeled
    // chunks without changing the underlying content.
    const char *sep1 = strchr(str, '@');
    if (!sep1)
    {
        // Fallback path: send the whole payload with a single prefix.
        printk("@%s\n", str);
        return;
    }
    const char *sep2 = strchr(sep1 + 1, '@');
    if (!sep2)
    {
        // Same fallback when the payload is malformed and only contains one separator.
        printk("@%s\n", str);
        return;
    }

    const char *pub_start = str;
    size_t pub_len = (size_t) (sep1 - pub_start);
    const char *sig_start = sep1 + 1;
    size_t sig_len = (size_t) (sep2 - sig_start);
    const char *msg_start = sep2 + 1;
    size_t msg_len = strlen(msg_start);

    auto send_labeled = [&](const char *label, const char *data, size_t len)
    {
        size_t offset = 0;
        // Emit a start marker so the receiver knows which logical field follows.
        printk("@%s\n", label);
        while (offset < len)
        {
            size_t to_send = (len - offset) > CHUNK_SIZE ? CHUNK_SIZE : (len - offset);
            printk("%.*s", (int) to_send, data + offset);
            offset += to_send;
            k_msleep(20);
        }
        // Close each field with an explicit end marker to keep parsing simple.
        printk("\n@END_%s\n", label);
        k_msleep(10);
    };

    // Send the three logical fields in a fixed order so the host can map them
    // back to the correct verification inputs.
    send_labeled("PUB", pub_start, pub_len);
    send_labeled("SIG", sig_start, sig_len);
    send_labeled("MSG", msg_start, msg_len);

    // Final marker for the end of the combined payload.
    printk("@END_ALL\n");
}

/**
 * @brief Send a text line (Char array) to the USB host.
 *
 * Adds a small delay before the send so short log bursts do not overrun the
 * host-side capture rate.
 *
 * @param [in] str Null-terminated string to print.
 * @return None.
 */
void USB_print(const char *str)
{
    k_msleep(SLEEP_TIME_MS);
    printk("%s\n", str);
}


/**
 * @brief Send structured CSV test results over USB.
 *
 * Delimits the payload so the host can capture the full CSV block without
 * mixing it with normal log output.
 * uses #start# and #stop# markers to indicate the beginning and end of the structured payload
 *
 * @param [in] str Null-terminated CSV text with embedded newlines preserved.
 * @return None.
 */
void USB_send_structured_data(const char *str)
{
    const size_t CHUNK_SIZE = 256;
    size_t len = strlen(str);
    size_t offset = 0;

    // Mark the beginning of the structured payload.
    k_msleep(SLEEP_TIME_MS);
    printk("#start#\n");

    // Stream in chunks so the transport stays responsive on slower links.
    while (offset < len)
    {
        size_t to_send = (len - offset) > CHUNK_SIZE ? CHUNK_SIZE : (len - offset);
        printk("%.*s", (int) to_send, str + offset);
        offset += to_send;
        k_msleep(20); // Short pause between chunks for stability
    }

    // Close the payload cleanly so the receiver can stop reading at once.
    printk("\n#stop#\n");
}
```

## src/USBcommunication.h
```c
#ifndef USBCOMMUNICATION_H
#define USBCOMMUNICATION_H

/**
 * @brief Send a combined payload containing public key, signature and message.
 *
 * The expected format is: base64(pub)@base64(sig)@base64(message). The
 * implementation splits and transmits labeled chunks so the host can parse
 * and verify each part independently.
 *
 * @param [in] str Null-terminated combined payload string.
 */
void USB_send_key_and_signature(const char *str);

/**
 * @brief Print a log line to the USB console.
 *
 * Adds a small delay for transport stability; intended for human-readable
 * diagnostic messages.
 *
 * @param [in] str Null-terminated string to print.
 */
void USB_print(const char *str);

/**
 * @brief Send structured CSV data over USB.
 *
 * The function wraps the provided CSV payload with start/stop markers so the
 * receiver can capture the block atomically.
 *
 * @param [in] str Null-terminated CSV text (may contain newlines).
 */
void USB_send_structured_data(const char *str);

#endif
```
